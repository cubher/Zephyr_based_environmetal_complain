## zephyrproject/app_v2/build/Kconfig/soc/Kconfig.sysbuild
```kconfig
# Load Sysbuild SoC Kconfig descriptions.
osource "F:/Workspace/smart_environmental/zephyrproject/zephyr/soc/xlnx/zynqmp/Kconfig.sysbuild"
osource "F:/Workspace/smart_environmental/zephyrproject/zephyr/soc/xlnx/zynq7000/Kconfig.sysbuild"
osource "F:/Workspace/smart_environmental/zephyrproject/zephyr/soc/xlnx/versalnet/Kconfig.sysbuild"
osource "F:/Workspace/smart_environmental/zephyrproject/zephyr/soc/xlnx/versal2/Kconfig.sysbuild"
osource "F:/Workspace/smart_environmental/zephyrproject/zephyr/soc/xen/Kconfig.sysbuild"
osource "F:/Workspace/smart_environmental/zephyrproject/zephyr/soc/wch/ch32v/Kconfig.sysbuild"
osource "F:/Workspace/smart_environmental/zephyrproject/zephyr/soc/ti/simplelink/Kconfig.sysbuild"
osource "F:/Workspace/smart_environmental/zephyrproject/zephyr/soc/ti/mspm0/Kconfig.sysbuild"
osource "F:/Workspace/smart_environmental/zephyrproject/zephyr/soc/ti/lm3s6965/Kconfig.sysbuild"
osource "F:/Workspace/smart_environmental/zephyrproject/zephyr/soc/ti/k3/Kconfig.sysbuild"
osource "F:/Workspace/smart_environmental/zephyrproject/zephyr/soc/telink/tlsr/Kconfig.sysbuild"
osource "F:/Workspace/smart_environmental/zephyrproject/zephyr/soc/starfive/jh71xx/Kconfig.sysbuild"
osource "F:/Workspace/smart_environmental/zephyrproject/zephyr/soc/st/stm32/Kconfig.sysbuild"
osource "F:/Workspace/smart_environmental/zephyrproject/zephyr/soc/snps/qemu_arc/Kconfig.sysbuild"
osource "F:/Workspace/smart_environmental/zephyrproject/zephyr/soc/snps/nsim/arc_v/Kconfig.sysbuild"
osource "F:/Workspace/smart_environmental/zephyrproject/zephyr/soc/snps/nsim/arc_classic/Kconfig.sysbuild"
osource "F:/Workspace/smart_environmental/zephyrproject/zephyr/soc/snps/hsdk4xd/Kconfig.sysbuild"
osource "F:/Workspace/smart_environmental/zephyrproject/zephyr/soc/snps/hsdk/Kconfig.sysbuild"
osource "F:/Workspace/smart_environmental/zephyrproject/zephyr/soc/snps/emsk/Kconfig.sysbuild"
osource "F:/Workspace/smart_environmental/zephyrproject/zephyr/soc/snps/emsdp/Kconfig.sysbuild"
osource "F:/Workspace/smart_environmental/zephyrproject/zephyr/soc/snps/arc_iot/Kconfig.sysbuild"
osource "F:/Workspace/smart_environmental/zephyrproject/zephyr/soc/silabs/Kconfig.sysbuild"
osource "F:/Workspace/smart_environmental/zephyrproject/zephyr/soc/sifive/sifive_freedom/Kconfig.sysbuild"
osource "F:/Workspace/smart_environmental/zephyrproject/zephyr/soc/sensry/Kconfig.sysbuild"
osource "F:/Workspace/smart_environmental/zephyrproject/zephyr/soc/rockchip/Kconfig.sysbuild"
osource "F:/Workspace/smart_environmental/zephyrproject/zephyr/soc/renode/riscv_virtual/Kconfig.sysbuild"
osource "F:/Workspace/smart_environmental/zephyrproject/zephyr/soc/renode/cortex_r8_virtual/Kconfig.sysbuild"
osource "F:/Workspace/smart_environmental/zephyrproject/zephyr/soc/renesas/smartbond/Kconfig.sysbuild"
osource "F:/Workspace/smart_environmental/zephyrproject/zephyr/soc/renesas/rz/Kconfig.sysbuild"
osource "F:/Workspace/smart_environmental/zephyrproject/zephyr/soc/renesas/rx/Kconfig.sysbuild"
osource "F:/Workspace/smart_environmental/zephyrproject/zephyr/soc/renesas/rcar/Kconfig.sysbuild"
osource "F:/Workspace/smart_environmental/zephyrproject/zephyr/soc/renesas/ra/Kconfig.sysbuild"
osource "F:/Workspace/smart_environmental/zephyrproject/zephyr/soc/realtek/ec/Kconfig.sysbuild"
osource "F:/Workspace/smart_environmental/zephyrproject/zephyr/soc/raspberrypi/rpi_pico/Kconfig.sysbuild"
osource "F:/Workspace/smart_environmental/zephyrproject/zephyr/soc/quicklogic/eos_s3/Kconfig.sysbuild"
osource "F:/Workspace/smart_environmental/zephyrproject/zephyr/soc/qemu/virt_riscv/Kconfig.sysbuild"
osource "F:/Workspace/smart_environmental/zephyrproject/zephyr/soc/qemu/malta/Kconfig.sysbuild"
osource "F:/Workspace/smart_environmental/zephyrproject/zephyr/soc/openisa/rv32m1/Kconfig.sysbuild"
osource "F:/Workspace/smart_environmental/zephyrproject/zephyr/soc/openhwgroup/cva6/Kconfig.sysbuild"
osource "F:/Workspace/smart_environmental/zephyrproject/zephyr/soc/oct/osd32mp15x/Kconfig.sysbuild"
osource "F:/Workspace/smart_environmental/zephyrproject/zephyr/soc/nxp/s32/Kconfig.sysbuild"
osource "F:/Workspace/smart_environmental/zephyrproject/zephyr/soc/nxp/rw/Kconfig.sysbuild"
osource "F:/Workspace/smart_environmental/zephyrproject/zephyr/soc/nxp/mcx/Kconfig.sysbuild"
osource "F:/Workspace/smart_environmental/zephyrproject/zephyr/soc/nxp/lpc/Kconfig.sysbuild"
osource "F:/Workspace/smart_environmental/zephyrproject/zephyr/soc/nxp/layerscape/Kconfig.sysbuild"
osource "F:/Workspace/smart_environmental/zephyrproject/zephyr/soc/nxp/kinetis/Kconfig.sysbuild"
osource "F:/Workspace/smart_environmental/zephyrproject/zephyr/soc/nxp/imxrt/Kconfig.sysbuild"
osource "F:/Workspace/smart_environmental/zephyrproject/zephyr/soc/nxp/imx/Kconfig.sysbuild"
osource "F:/Workspace/smart_environmental/zephyrproject/zephyr/soc/nuvoton/numicro/Kconfig.sysbuild"
osource "F:/Workspace/smart_environmental/zephyrproject/zephyr/soc/nuvoton/numaker/Kconfig.sysbuild"
osource "F:/Workspace/smart_environmental/zephyrproject/zephyr/soc/nuvoton/npcx/Kconfig.sysbuild"
osource "F:/Workspace/smart_environmental/zephyrproject/zephyr/soc/nuvoton/npcm/Kconfig.sysbuild"
osource "F:/Workspace/smart_environmental/zephyrproject/zephyr/soc/nordic/Kconfig.sysbuild"
osource "F:/Workspace/smart_environmental/zephyrproject/zephyr/soc/neorv32/Kconfig.sysbuild"
osource "F:/Workspace/smart_environmental/zephyrproject/zephyr/soc/native/inf_clock/Kconfig.sysbuild"
osource "F:/Workspace/smart_environmental/zephyrproject/zephyr/soc/microchip/sam/Kconfig.sysbuild"
osource "F:/Workspace/smart_environmental/zephyrproject/zephyr/soc/microchip/sam/sam_d5x_e5x/Kconfig.sysbuild"
osource "F:/Workspace/smart_environmental/zephyrproject/zephyr/soc/microchip/miv/Kconfig.sysbuild"
osource "F:/Workspace/smart_environmental/zephyrproject/zephyr/soc/microchip/mec/Kconfig.sysbuild"
osource "F:/Workspace/smart_environmental/zephyrproject/zephyr/soc/mediatek/mt8xxx/Kconfig.sysbuild"
osource "F:/Workspace/smart_environmental/zephyrproject/zephyr/soc/lowrisc/opentitan/Kconfig.sysbuild"
osource "F:/Workspace/smart_environmental/zephyrproject/zephyr/soc/litex/litex_vexriscv/Kconfig.sysbuild"
osource "F:/Workspace/smart_environmental/zephyrproject/zephyr/soc/ite/ec/Kconfig.sysbuild"
osource "F:/Workspace/smart_environmental/zephyrproject/zephyr/soc/intel/raptor_lake/Kconfig.sysbuild"
osource "F:/Workspace/smart_environmental/zephyrproject/zephyr/soc/intel/panther_lake/Kconfig.sysbuild"
osource "F:/Workspace/smart_environmental/zephyrproject/zephyr/soc/intel/lakemont/Kconfig.sysbuild"
osource "F:/Workspace/smart_environmental/zephyrproject/zephyr/soc/intel/intel_socfpga_std/Kconfig.sysbuild"
osource "F:/Workspace/smart_environmental/zephyrproject/zephyr/soc/intel/intel_socfpga/Kconfig.sysbuild"
osource "F:/Workspace/smart_environmental/zephyrproject/zephyr/soc/intel/intel_niosv/Kconfig.sysbuild"
osource "F:/Workspace/smart_environmental/zephyrproject/zephyr/soc/intel/intel_ish/Kconfig.sysbuild"
osource "F:/Workspace/smart_environmental/zephyrproject/zephyr/soc/intel/intel_adsp/Kconfig.sysbuild"
osource "F:/Workspace/smart_environmental/zephyrproject/zephyr/soc/intel/elkhart_lake/Kconfig.sysbuild"
osource "F:/Workspace/smart_environmental/zephyrproject/zephyr/soc/intel/atom/Kconfig.sysbuild"
osource "F:/Workspace/smart_environmental/zephyrproject/zephyr/soc/intel/apollo_lake/Kconfig.sysbuild"
osource "F:/Workspace/smart_environmental/zephyrproject/zephyr/soc/intel/alder_lake/Kconfig.sysbuild"
osource "F:/Workspace/smart_environmental/zephyrproject/zephyr/soc/infineon/cat3/Kconfig.sysbuild"
osource "F:/Workspace/smart_environmental/zephyrproject/zephyr/soc/infineon/cat1c/Kconfig.sysbuild"
osource "F:/Workspace/smart_environmental/zephyrproject/zephyr/soc/infineon/cat1b/Kconfig.sysbuild"
osource "F:/Workspace/smart_environmental/zephyrproject/zephyr/soc/infineon/cat1a/Kconfig.sysbuild"
osource "F:/Workspace/smart_environmental/zephyrproject/zephyr/soc/gd/gd32/Kconfig.sysbuild"
osource "F:/Workspace/smart_environmental/zephyrproject/zephyr/soc/gaisler/leon3/Kconfig.sysbuild"
osource "F:/Workspace/smart_environmental/zephyrproject/zephyr/soc/gaisler/gr716a/Kconfig.sysbuild"
osource "F:/Workspace/smart_environmental/zephyrproject/zephyr/soc/espressif/Kconfig.sysbuild"
osource "F:/Workspace/smart_environmental/zephyrproject/zephyr/soc/ene/kb1200/Kconfig.sysbuild"
osource "F:/Workspace/smart_environmental/zephyrproject/zephyr/soc/ene/kb106x/Kconfig.sysbuild"
osource "F:/Workspace/smart_environmental/zephyrproject/zephyr/soc/efinix/sapphire/Kconfig.sysbuild"
osource "F:/Workspace/smart_environmental/zephyrproject/zephyr/soc/cdns/xtensa_sample_controller/Kconfig.sysbuild"
osource "F:/Workspace/smart_environmental/zephyrproject/zephyr/soc/cdns/sample_controller32/Kconfig.sysbuild"
osource "F:/Workspace/smart_environmental/zephyrproject/zephyr/soc/cdns/dc233c/Kconfig.sysbuild"
osource "F:/Workspace/smart_environmental/zephyrproject/zephyr/soc/brcm/bcmvk/Kconfig.sysbuild"
osource "F:/Workspace/smart_environmental/zephyrproject/zephyr/soc/brcm/bcm2712/Kconfig.sysbuild"
osource "F:/Workspace/smart_environmental/zephyrproject/zephyr/soc/brcm/bcm2711/Kconfig.sysbuild"
osource "F:/Workspace/smart_environmental/zephyrproject/zephyr/soc/bflb/Kconfig.sysbuild"
osource "F:/Workspace/smart_environmental/zephyrproject/zephyr/soc/atmel/sam0/Kconfig.sysbuild"
osource "F:/Workspace/smart_environmental/zephyrproject/zephyr/soc/atmel/sam/Kconfig.sysbuild"
osource "F:/Workspace/smart_environmental/zephyrproject/zephyr/soc/aspeed/Kconfig.sysbuild"
osource "F:/Workspace/smart_environmental/zephyrproject/zephyr/soc/arm/Kconfig.sysbuild"
osource "F:/Workspace/smart_environmental/zephyrproject/zephyr/soc/arm/beetle/Kconfig.sysbuild"
osource "F:/Workspace/smart_environmental/zephyrproject/zephyr/soc/antmicro/myra/Kconfig.sysbuild"
osource "F:/Workspace/smart_environmental/zephyrproject/zephyr/soc/andestech/Kconfig.sysbuild"
osource "F:/Workspace/smart_environmental/zephyrproject/zephyr/soc/amd/acp_6_0/Kconfig.sysbuild"
osource "F:/Workspace/smart_environmental/zephyrproject/zephyr/soc/ambiq/Kconfig.sysbuild"
osource "F:/Workspace/smart_environmental/zephyrproject/zephyr/soc/aesc/Kconfig.sysbuild"
osource "F:/Workspace/smart_environmental/zephyrproject/zephyr/soc/adi/max32/Kconfig.sysbuild"
```
