## zephyrproject/app_v2/build/Kconfig/arch/Kconfig
```kconfig
# Load Zephyr Arch Kconfig descriptions.
osource "F:/Workspace/smart_environmental/zephyrproject/zephyr/arch/rx/Kconfig"
osource "F:/Workspace/smart_environmental/zephyrproject/zephyr/arch/x86/Kconfig"
osource "F:/Workspace/smart_environmental/zephyrproject/zephyr/arch/xtensa/Kconfig"
osource "F:/Workspace/smart_environmental/zephyrproject/zephyr/arch/sparc/Kconfig"
osource "F:/Workspace/smart_environmental/zephyrproject/zephyr/arch/riscv/Kconfig"
osource "F:/Workspace/smart_environmental/zephyrproject/zephyr/arch/posix/Kconfig"
osource "F:/Workspace/smart_environmental/zephyrproject/zephyr/arch/mips/Kconfig"
osource "F:/Workspace/smart_environmental/zephyrproject/zephyr/arch/arm64/Kconfig"
osource "F:/Workspace/smart_environmental/zephyrproject/zephyr/arch/arm/Kconfig"
osource "F:/Workspace/smart_environmental/zephyrproject/zephyr/arch/arc/Kconfig"
```

## zephyrproject/app_v2/build/Kconfig/boards/Kconfig
```kconfig
# Load Zephyr board Kconfig descriptions.
osource "F:/Workspace/smart_environmental/zephyrproject/zephyr/boards/st/nucleo_f103rb/Kconfig"
```

## zephyrproject/app_v2/build/Kconfig/boards/Kconfig.defconfig
```kconfig
# Load Zephyr board defconfig descriptions.
osource "F:/Workspace/smart_environmental/zephyrproject/zephyr/boards/st/nucleo_f103rb/Kconfig.defconfig"
```

## zephyrproject/app_v2/build/Kconfig/boards/Kconfig.nucleo_f103rb
```kconfig
# Load board Kconfig descriptions.
osource "F:/Workspace/smart_environmental/zephyrproject/zephyr/boards/st/nucleo_f103rb/Kconfig.nucleo_f103rb"
```

## zephyrproject/app_v2/build/Kconfig/boards/Kconfig.sysbuild
```kconfig
# Load Sysbuild board Kconfig descriptions.
osource "F:/Workspace/smart_environmental/zephyrproject/zephyr/boards/st/nucleo_f103rb/Kconfig.sysbuild"
```

## zephyrproject/app_v2/build/Kconfig/soc/Kconfig
```kconfig
# Load Zephyr SoC Kconfig descriptions.
osource "F:/Workspace/smart_environmental/zephyrproject/zephyr/soc/xlnx/zynqmp/Kconfig"
osource "F:/Workspace/smart_environmental/zephyrproject/zephyr/soc/xlnx/zynq7000/Kconfig"
osource "F:/Workspace/smart_environmental/zephyrproject/zephyr/soc/xlnx/versalnet/Kconfig"
osource "F:/Workspace/smart_environmental/zephyrproject/zephyr/soc/xlnx/versal2/Kconfig"
osource "F:/Workspace/smart_environmental/zephyrproject/zephyr/soc/xen/Kconfig"
osource "F:/Workspace/smart_environmental/zephyrproject/zephyr/soc/wch/ch32v/Kconfig"
osource "F:/Workspace/smart_environmental/zephyrproject/zephyr/soc/ti/simplelink/Kconfig"
osource "F:/Workspace/smart_environmental/zephyrproject/zephyr/soc/ti/mspm0/Kconfig"
osource "F:/Workspace/smart_environmental/zephyrproject/zephyr/soc/ti/lm3s6965/Kconfig"
osource "F:/Workspace/smart_environmental/zephyrproject/zephyr/soc/ti/k3/Kconfig"
osource "F:/Workspace/smart_environmental/zephyrproject/zephyr/soc/telink/tlsr/Kconfig"
osource "F:/Workspace/smart_environmental/zephyrproject/zephyr/soc/starfive/jh71xx/Kconfig"
osource "F:/Workspace/smart_environmental/zephyrproject/zephyr/soc/st/stm32/Kconfig"
osource "F:/Workspace/smart_environmental/zephyrproject/zephyr/soc/snps/qemu_arc/Kconfig"
osource "F:/Workspace/smart_environmental/zephyrproject/zephyr/soc/snps/nsim/arc_v/Kconfig"
osource "F:/Workspace/smart_environmental/zephyrproject/zephyr/soc/snps/nsim/arc_classic/Kconfig"
osource "F:/Workspace/smart_environmental/zephyrproject/zephyr/soc/snps/hsdk4xd/Kconfig"
osource "F:/Workspace/smart_environmental/zephyrproject/zephyr/soc/snps/hsdk/Kconfig"
osource "F:/Workspace/smart_environmental/zephyrproject/zephyr/soc/snps/emsk/Kconfig"
osource "F:/Workspace/smart_environmental/zephyrproject/zephyr/soc/snps/emsdp/Kconfig"
osource "F:/Workspace/smart_environmental/zephyrproject/zephyr/soc/snps/arc_iot/Kconfig"
osource "F:/Workspace/smart_environmental/zephyrproject/zephyr/soc/silabs/Kconfig"
osource "F:/Workspace/smart_environmental/zephyrproject/zephyr/soc/sifive/sifive_freedom/Kconfig"
osource "F:/Workspace/smart_environmental/zephyrproject/zephyr/soc/sensry/Kconfig"
osource "F:/Workspace/smart_environmental/zephyrproject/zephyr/soc/rockchip/Kconfig"
osource "F:/Workspace/smart_environmental/zephyrproject/zephyr/soc/renode/riscv_virtual/Kconfig"
osource "F:/Workspace/smart_environmental/zephyrproject/zephyr/soc/renode/cortex_r8_virtual/Kconfig"
osource "F:/Workspace/smart_environmental/zephyrproject/zephyr/soc/renesas/smartbond/Kconfig"
osource "F:/Workspace/smart_environmental/zephyrproject/zephyr/soc/renesas/rz/Kconfig"
osource "F:/Workspace/smart_environmental/zephyrproject/zephyr/soc/renesas/rx/Kconfig"
osource "F:/Workspace/smart_environmental/zephyrproject/zephyr/soc/renesas/rcar/Kconfig"
osource "F:/Workspace/smart_environmental/zephyrproject/zephyr/soc/renesas/ra/Kconfig"
osource "F:/Workspace/smart_environmental/zephyrproject/zephyr/soc/realtek/ec/Kconfig"
osource "F:/Workspace/smart_environmental/zephyrproject/zephyr/soc/raspberrypi/rpi_pico/Kconfig"
osource "F:/Workspace/smart_environmental/zephyrproject/zephyr/soc/quicklogic/eos_s3/Kconfig"
osource "F:/Workspace/smart_environmental/zephyrproject/zephyr/soc/qemu/virt_riscv/Kconfig"
osource "F:/Workspace/smart_environmental/zephyrproject/zephyr/soc/qemu/malta/Kconfig"
osource "F:/Workspace/smart_environmental/zephyrproject/zephyr/soc/openisa/rv32m1/Kconfig"
osource "F:/Workspace/smart_environmental/zephyrproject/zephyr/soc/openhwgroup/cva6/Kconfig"
osource "F:/Workspace/smart_environmental/zephyrproject/zephyr/soc/oct/osd32mp15x/Kconfig"
osource "F:/Workspace/smart_environmental/zephyrproject/zephyr/soc/nxp/s32/Kconfig"
osource "F:/Workspace/smart_environmental/zephyrproject/zephyr/soc/nxp/rw/Kconfig"
osource "F:/Workspace/smart_environmental/zephyrproject/zephyr/soc/nxp/mcx/Kconfig"
osource "F:/Workspace/smart_environmental/zephyrproject/zephyr/soc/nxp/lpc/Kconfig"
osource "F:/Workspace/smart_environmental/zephyrproject/zephyr/soc/nxp/layerscape/Kconfig"
osource "F:/Workspace/smart_environmental/zephyrproject/zephyr/soc/nxp/kinetis/Kconfig"
osource "F:/Workspace/smart_environmental/zephyrproject/zephyr/soc/nxp/imxrt/Kconfig"
osource "F:/Workspace/smart_environmental/zephyrproject/zephyr/soc/nxp/imx/Kconfig"
osource "F:/Workspace/smart_environmental/zephyrproject/zephyr/soc/nuvoton/numicro/Kconfig"
osource "F:/Workspace/smart_environmental/zephyrproject/zephyr/soc/nuvoton/numaker/Kconfig"
osource "F:/Workspace/smart_environmental/zephyrproject/zephyr/soc/nuvoton/npcx/Kconfig"
osource "F:/Workspace/smart_environmental/zephyrproject/zephyr/soc/nuvoton/npcm/Kconfig"
osource "F:/Workspace/smart_environmental/zephyrproject/zephyr/soc/nordic/Kconfig"
osource "F:/Workspace/smart_environmental/zephyrproject/zephyr/soc/neorv32/Kconfig"
osource "F:/Workspace/smart_environmental/zephyrproject/zephyr/soc/native/inf_clock/Kconfig"
osource "F:/Workspace/smart_environmental/zephyrproject/zephyr/soc/microchip/sam/Kconfig"
osource "F:/Workspace/smart_environmental/zephyrproject/zephyr/soc/microchip/sam/sam_d5x_e5x/Kconfig"
osource "F:/Workspace/smart_environmental/zephyrproject/zephyr/soc/microchip/miv/Kconfig"
osource "F:/Workspace/smart_environmental/zephyrproject/zephyr/soc/microchip/mec/Kconfig"
osource "F:/Workspace/smart_environmental/zephyrproject/zephyr/soc/mediatek/mt8xxx/Kconfig"
osource "F:/Workspace/smart_environmental/zephyrproject/zephyr/soc/lowrisc/opentitan/Kconfig"
osource "F:/Workspace/smart_environmental/zephyrproject/zephyr/soc/litex/litex_vexriscv/Kconfig"
osource "F:/Workspace/smart_environmental/zephyrproject/zephyr/soc/ite/ec/Kconfig"
osource "F:/Workspace/smart_environmental/zephyrproject/zephyr/soc/intel/raptor_lake/Kconfig"
osource "F:/Workspace/smart_environmental/zephyrproject/zephyr/soc/intel/panther_lake/Kconfig"
osource "F:/Workspace/smart_environmental/zephyrproject/zephyr/soc/intel/lakemont/Kconfig"
osource "F:/Workspace/smart_environmental/zephyrproject/zephyr/soc/intel/intel_socfpga_std/Kconfig"
osource "F:/Workspace/smart_environmental/zephyrproject/zephyr/soc/intel/intel_socfpga/Kconfig"
osource "F:/Workspace/smart_environmental/zephyrproject/zephyr/soc/intel/intel_niosv/Kconfig"
osource "F:/Workspace/smart_environmental/zephyrproject/zephyr/soc/intel/intel_ish/Kconfig"
osource "F:/Workspace/smart_environmental/zephyrproject/zephyr/soc/intel/intel_adsp/Kconfig"
osource "F:/Workspace/smart_environmental/zephyrproject/zephyr/soc/intel/elkhart_lake/Kconfig"
osource "F:/Workspace/smart_environmental/zephyrproject/zephyr/soc/intel/atom/Kconfig"
osource "F:/Workspace/smart_environmental/zephyrproject/zephyr/soc/intel/apollo_lake/Kconfig"
osource "F:/Workspace/smart_environmental/zephyrproject/zephyr/soc/intel/alder_lake/Kconfig"
osource "F:/Workspace/smart_environmental/zephyrproject/zephyr/soc/infineon/cat3/Kconfig"
osource "F:/Workspace/smart_environmental/zephyrproject/zephyr/soc/infineon/cat1c/Kconfig"
osource "F:/Workspace/smart_environmental/zephyrproject/zephyr/soc/infineon/cat1b/Kconfig"
osource "F:/Workspace/smart_environmental/zephyrproject/zephyr/soc/infineon/cat1a/Kconfig"
osource "F:/Workspace/smart_environmental/zephyrproject/zephyr/soc/gd/gd32/Kconfig"
osource "F:/Workspace/smart_environmental/zephyrproject/zephyr/soc/gaisler/leon3/Kconfig"
osource "F:/Workspace/smart_environmental/zephyrproject/zephyr/soc/gaisler/gr716a/Kconfig"
osource "F:/Workspace/smart_environmental/zephyrproject/zephyr/soc/espressif/Kconfig"
osource "F:/Workspace/smart_environmental/zephyrproject/zephyr/soc/ene/kb1200/Kconfig"
osource "F:/Workspace/smart_environmental/zephyrproject/zephyr/soc/ene/kb106x/Kconfig"
osource "F:/Workspace/smart_environmental/zephyrproject/zephyr/soc/efinix/sapphire/Kconfig"
osource "F:/Workspace/smart_environmental/zephyrproject/zephyr/soc/cdns/xtensa_sample_controller/Kconfig"
osource "F:/Workspace/smart_environmental/zephyrproject/zephyr/soc/cdns/sample_controller32/Kconfig"
osource "F:/Workspace/smart_environmental/zephyrproject/zephyr/soc/cdns/dc233c/Kconfig"
osource "F:/Workspace/smart_environmental/zephyrproject/zephyr/soc/brcm/bcmvk/Kconfig"
osource "F:/Workspace/smart_environmental/zephyrproject/zephyr/soc/brcm/bcm2712/Kconfig"
osource "F:/Workspace/smart_environmental/zephyrproject/zephyr/soc/brcm/bcm2711/Kconfig"
osource "F:/Workspace/smart_environmental/zephyrproject/zephyr/soc/bflb/Kconfig"
osource "F:/Workspace/smart_environmental/zephyrproject/zephyr/soc/atmel/sam0/Kconfig"
osource "F:/Workspace/smart_environmental/zephyrproject/zephyr/soc/atmel/sam/Kconfig"
osource "F:/Workspace/smart_environmental/zephyrproject/zephyr/soc/aspeed/Kconfig"
osource "F:/Workspace/smart_environmental/zephyrproject/zephyr/soc/arm/Kconfig"
osource "F:/Workspace/smart_environmental/zephyrproject/zephyr/soc/arm/beetle/Kconfig"
osource "F:/Workspace/smart_environmental/zephyrproject/zephyr/soc/antmicro/myra/Kconfig"
osource "F:/Workspace/smart_environmental/zephyrproject/zephyr/soc/andestech/Kconfig"
osource "F:/Workspace/smart_environmental/zephyrproject/zephyr/soc/amd/acp_6_0/Kconfig"
osource "F:/Workspace/smart_environmental/zephyrproject/zephyr/soc/ambiq/Kconfig"
osource "F:/Workspace/smart_environmental/zephyrproject/zephyr/soc/aesc/Kconfig"
osource "F:/Workspace/smart_environmental/zephyrproject/zephyr/soc/adi/max32/Kconfig"
```
